## sources/meta-cywlan/conf/layer.conf
```bitbake
# We have a conf and classes directory, add to BBPATH
BBPATH .= ":${LAYERDIR}"

# We have recipes-* directories, add to BBFILES
BBFILES += "${LAYERDIR}/recipes-*/*/*.bb \
	${LAYERDIR}/recipes-*/*/*.bbappend"

BBFILE_COLLECTIONS += "cywlan"
BBFILE_PATTERN_cywlan = "^${LAYERDIR}/"
BBFILE_PRIORITY_cywlan = "9"

#LAYERSERIES_COMPAT_cywlan = "zeus"
LAYERSERIES_COMPAT_cywlan = "gatesgarth hardknott"


BBMASK += "/meta-fsl-bsp-release/imx/meta-bsp/recipes-connectivity/hostapd/"
BBMASK += "/meta-fsl-bsp-release/imx/meta-bsp/recipes-connectivity/wpa-supplicant/"
```
